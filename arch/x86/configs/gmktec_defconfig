## drivers/net/usb/r8152_dkms/Kconfig
```kconfig
# SPDX-License-Identifier: GPL-2.0-only
#
# RealTek DKMS USB Network devices configuration
#

if USB_NET_DRIVERS

config USB_RTL8152_DKMS
	tristate "Realtek DKMS RTL8152/RTL8153 USB Adapters driver"
	depends on USB_RTL8152=n
	select MII
	select PHYLIB
	select CRC32
	select CRYPTO_LIB_SHA256
	help
	  This option adds support for Realtek RTL8152 based USB 2.0
	  10/100 Ethernet adapters and RTL8153 based USB 3.0 10/100/1000
	  Ethernet adapters.

	  To compile this driver as a module, choose M here: the
	  module will be called r8152_dkms.

endif # USB_NET_DRIVERS && !USB_RTL8152
```
